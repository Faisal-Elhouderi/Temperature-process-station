#include <Arduino.h>
#include <SPIFFS.h>
#include <math.h>

// =========================================================
//  ESP32 Temperature Station: Minimum Variance Controller (MVC / GMV)
//  PlatformIO (Arduino framework)
//
//  Tuned controller coefficients are embedded from mvc_data2a.mat.
//
//  Sampling:
//    Ts = 0.5 s  (must match SAMPLE_INTERVAL_MS)
//    delay d = 25 samples (12.5 s)
//
//  Signals (STATION volts):
//    - y_st: plant output in [1..5] V  (measured via divider into ADC)
//    - u_st: plant input  in [1..5] V  (generated by DAC 0..3.3 V + amplifier)
//    - r_st: desired output (reference) in station volts [1..5]
//
//  Scaling you described:
//    * Output path:  y_st (1..5V) -> divider -> y_adc (~0.67..3.3V)
//      We use: y_st = y_adc / DIV_RATIO   with DIV_RATIO ~= 2/3
//
//    * Input path: DAC v_dac (0..3.3V) -> amplifier -> u_st (1..5V)
//      We use: u_st = 1 + (4/3.3) * v_dac
//      => v_dac = (u_st - 1) * (3.3/4)
//
//  Controller law (deviation form around enable-time operating point):
//      Q(q^-1) u_dev(k) = C(q^-1) r_ctrl(k) - F(q^-1) y_dev(k)
//    where:
//      y_dev = y_st - y_base,  u_dev = u_st - u_base
//
//  Reference preview (recommended, because you know your command ahead):
//    1st-order prefilter: r_f = r_f + alpha*(r_dev - r_f)
//    preview approx:      r_ctrl = r_dev + (r_f - r_dev) * (1-alpha)^d
//
//  Notes:
//    - For other operating points you may need gain scheduling.
// =========================================================


// ==================== CONFIGURATION ====================

// Base sampling interval (ms)  -> MUST be 500ms for Ts=0.5s
const unsigned long SAMPLE_INTERVAL_MS = 500;

// Moving average window length (read one ADC sample each SAMPLE_INTERVAL_MS)
// Thermal plants are slow, so this is ok. If you want less delay, reduce to 3 or 1.
const int AVG_WINDOW = 4;

// Controller update rate (every N samples)
const int CTRL_UPDATE_EVERY_N_SAMPLES = 1;

// ADC input pin (sensor voltage from station AFTER divider)
const int ADC_PIN = 34;

// DAC output pin (ESP32 DAC)
const int DAC_PIN = 25;

// Station output voltage divider ratio:
//   Vadc = Vstation * DIV_RATIO
// For 1..5 V -> 0.667..3.333 V, DIV_RATIO = 2/3
const float DIV_RATIO = 2.0f / 3.0f;

// Station input mapping (DAC -> station input)
const float U_ST_FROM_DAC_OFFSET = 1.0f;         // station volts
const float U_ST_FROM_DAC_GAIN   = 4.0f / 3.3f;  // station V per DAC V
const float DAC_FROM_U_ST_GAIN   = 3.3f / 4.0f;  // DAC V per station V (above offset)

// Station actuator limits (station volts)
const float U_ST_MIN_V = 1.0f;
const float U_ST_MAX_V = 5.0f;

// Optional slew-rate limit on station input (V per sample). Set INFINITY to disable.
const float DU_ST_MAX_PER_SAMPLE = INFINITY;

// Reference limits (station output volts)
const float Y_ST_MIN_V = 1.0f;
const float Y_ST_MAX_V = 5.0f;

// Default manual station input when controller is disabled (station volts)
float manualUStationV = 1.4f;

// Default reference (desired output) in station volts
float refStationV = 1.4f;


// ==================== MVC PARAMETERS (from mvc_data2a.mat) ====================
// Ts = 0.5 s, d = 25, tau_ref = 2 s, alpha = 0.2, preview = 0.0037778931863

static const double MVC_TS_SEC = 0.5;
static const int    MVC_D      = 25;
static const double MVC_TAU_REF_SEC = 2;
static const double MVC_ALPHA       = 0.2;
static const double MVC_PREVIEW_FAC = 0.0037778931863;

static const double MVC_Q[25] = {
  0.000138681514519, 2.90979202187e-06, 2.9088171636e-06, 2.90784263193e-06, 2.90686842675e-06,
  2.90589454796e-06, 2.90492099545e-06, 2.9039477691e-06, 2.9029748688e-06, 2.90200229446e-06,
  2.90103004595e-06, 2.90005812318e-06, 2.89908652602e-06, 2.89811525438e-06, 2.89714430813e-06,
  2.89617368718e-06, 2.89520339142e-06, 2.89423342072e-06, 2.893263775e-06, 2.89229445413e-06,
  2.89132545801e-06, 2.89035678653e-06, 2.88938843958e-06, 2.88842041706e-06, 2.88745271884e-06
};

static const double MVC_C[2] = {
  1, -0.978683142779
};

static const double MVC_F0 = 0.0208137714305;

static const int MVC_NQ = 25;
static const int MVC_NC = 2;


// ==================== LOGGING ====================
const char* DATA_FILE = "/mvc.csv";
const size_t MAX_FILE_SIZE = 1000000;


// ==================== GLOBAL STATE ====================
unsigned long lastSampleTime = 0;
unsigned long sampleCount = 0;
bool loggingEnabled = true;
bool mvcEnabled = false;

// Moving average buffer (raw ADC counts)
int adcBuf[AVG_WINDOW] = {0};
int adcIdx = 0;
long adcSum = 0;
bool adcFilled = false;

// Current commanded station input/output
float uStationCmdV = 1.4f;   // station input volts (after amplifier)
float uDacCmdV     = 0.0f;   // DAC volts (0..3.3)

// MVC operating point at enable
float yBase = 0.0f;          // station output at enable
float uBase = 1.4f;          // station input at enable

// Reference filter state (deviation)
float r_f = 0.0f;

// Histories (deviation signals)
double u_hist[25 - 1] = {0};  // u_dev(k-1), u_dev(k-2), ...
double r_hist[2]     = {0};  // r_ctrl(k), r_ctrl(k-1)


// ==================== HELPERS ====================
static inline float clampf(float x, float lo, float hi) {
  if (x < lo) return lo;
  if (x > hi) return hi;
  return x;
}

static inline double clampd(double x, double lo, double hi) {
  if (x < lo) return lo;
  if (x > hi) return hi;
  return x;
}

float adcToVoltage(int adcValue) {
  return (adcValue / 4095.0f) * 3.3f;
}

static inline float adcToStationVoltage(float vAdc) {
  return (DIV_RATIO <= 0.0f) ? vAdc : (vAdc / DIV_RATIO);
}

static inline float stationInputToDacVoltage(float uStation) {
  // v_dac = (u_st - offset) / gain
  return (uStation - U_ST_FROM_DAC_OFFSET) * DAC_FROM_U_ST_GAIN;
}

void setDacVoltage(float vDac) {
  vDac = clampf(vDac, 0.0f, 3.3f);
  uDacCmdV = vDac;

  // ESP32 DAC: 8-bit (0-255) for ~0-3.3V
  int dacValue = (int)((vDac / 3.3f) * 255.0f + 0.5f);
  dacWrite(DAC_PIN, dacValue);
}

void setStationInputVoltage(float uStation) {
  // Clamp in station volts then convert to DAC volts
  uStation = clampf(uStation, U_ST_MIN_V, U_ST_MAX_V);
  uStationCmdV = uStation;

  float vDac = stationInputToDacVoltage(uStation);
  setDacVoltage(vDac);
}

// Moving average update: read ADC once, update buffer, return average ADC-node voltage (Vadc)
float readAdcVoltageAveraged() {
  int raw = analogRead(ADC_PIN);

  if (!adcFilled) {
    adcBuf[adcIdx] = raw;
    adcSum += raw;
    adcIdx++;
    if (adcIdx >= AVG_WINDOW) {
      adcIdx = 0;
      adcFilled = true;
    }
  } else {
    adcSum -= adcBuf[adcIdx];
    adcBuf[adcIdx] = raw;
    adcSum += raw;
    adcIdx++;
    if (adcIdx >= AVG_WINDOW) adcIdx = 0;
  }

  int denom = adcFilled ? AVG_WINDOW : max(1, adcIdx);
  float avgAdc = (float)adcSum / (float)denom;
  return adcToVoltage((int)(avgAdc + 0.5f)); // Vadc
}

static inline void shiftRight(double* buf, int n) {
  for (int i = n - 1; i >= 1; --i) buf[i] = buf[i - 1];
}


// ==================== SPIFFS / LOGGING ====================
void initSPIFFS() {
  if (!SPIFFS.begin(true)) {
    Serial.println("ERROR: SPIFFS mount failed!");
    return;
  }
  Serial.println("SPIFFS mounted successfully");

  if (!SPIFFS.exists(DATA_FILE)) {
    File file = SPIFFS.open(DATA_FILE, FILE_WRITE);
    if (file) {
      file.println("timestamp_ms,ref_y_st,u_st_cmd,v_dac,v_adc_avg,y_st_avg,y_dev,r_f,r_ctrl,u_dev,sat");
      file.close();
      Serial.println("Created new MVC data file with header");
    }
  }
}

void clearDataFile() {
  File file = SPIFFS.open(DATA_FILE, FILE_WRITE);
  if (file) {
    file.println("timestamp_ms,ref_y_st,u_st_cmd,v_dac,v_adc_avg,y_st_avg,y_dev,r_f,r_ctrl,u_dev,sat");
    file.close();
    sampleCount = 0;
    Serial.println("Data file cleared");
  } else {
    Serial.println("ERROR: Could not clear file");
  }
}

void printFileContents() {
  Serial.println("\n========== FILE CONTENTS ==========");
  File file = SPIFFS.open(DATA_FILE, FILE_READ);
  if (file) {
    while (file.available()) {
      Serial.write(file.read());
    }
    file.close();
  } else {
    Serial.println("ERROR: Could not open file for reading");
  }
  Serial.println("====================================\n");
}

void printFileInfo() {
  Serial.println("\n---------- FILE INFO ----------");
  size_t totalBytes = SPIFFS.totalBytes();
  size_t usedBytes = SPIFFS.usedBytes();

  Serial.printf("SPIFFS Total: %u bytes\n", (unsigned)totalBytes);
  Serial.printf("SPIFFS Used:  %u bytes\n", (unsigned)usedBytes);
  Serial.printf("SPIFFS Free:  %u bytes\n", (unsigned)(totalBytes - usedBytes));

  File file = SPIFFS.open(DATA_FILE, FILE_READ);
  if (file) {
    Serial.printf("Data file size: %u bytes\n", (unsigned)file.size());

    size_t lines = 0;
    while (file.available()) {
      if (file.read() == '\n') lines++;
    }
    Serial.printf("Total samples: %u\n", (unsigned)(lines > 0 ? lines - 1 : 0));
    file.close();
  }
  Serial.println("-------------------------------\n");
}

bool logMvcRow(unsigned long timestampMs,
               float refY, float uSt, float vDac,
               float vAdc, float ySt,
               float yDev, float rF, float rCtrl, float uDev,
               int satFlag) {
  // Check file size
  File f = SPIFFS.open(DATA_FILE, FILE_READ);
  if (f) {
    size_t sz = f.size();
    f.close();
    if (sz >= MAX_FILE_SIZE) {
      Serial.println("WARNING: Max file size reached. Stopping logging.");
      loggingEnabled = false;
      return false;
    }
  }

  f = SPIFFS.open(DATA_FILE, FILE_APPEND);
  if (!f) {
    Serial.println("ERROR: Could not open file for writing");
    return false;
  }

  f.printf("%lu,%.4f,%.4f,%.4f,%.4f,%.4f,%.5f,%.5f,%.5f,%.5f,%d\n",
           timestampMs, refY, uSt, vDac, vAdc, ySt, yDev, rF, rCtrl, uDev, satFlag);
  f.close();
  return true;
}


// ==================== MVC STEP ====================
float mvcStep(float rAbs, float yAbs,
              float& yDev_out, float& rF_out, float& rCtrl_out, float& uDev_out,
              int& satFlag) {
  // Deviation measurement
  double yDev = (double)yAbs - (double)yBase;

  // Deviation reference (relative to enable-time yBase)
  double rDev = (double)rAbs - (double)yBase;

  // 1st-order prefilter on deviation reference
  r_f = (float)((double)r_f + MVC_ALPHA * (rDev - (double)r_f));
  double rF = (double)r_f;

  // Previewed reference for controller (good for piecewise-constant r)
  double rCtrl = rDev + (rF - rDev) * MVC_PREVIEW_FAC;

  // Update r history: r_hist[0]=rCtrl(k), r_hist[1]=rCtrl(k-1)
  shiftRight(r_hist, MVC_NC);
  r_hist[0] = rCtrl;

  // rhs = sum C[i]*r_hist[i] - F0*yDev - sum_{i=1..NQ-1} Q[i]*u_hist[i-1]
  double rhs = 0.0;

  for (int i = 0; i < MVC_NC; ++i) rhs += MVC_C[i] * r_hist[i];
  rhs -= MVC_F0 * yDev;

  for (int i = 1; i < MVC_NQ; ++i) rhs -= MVC_Q[i] * u_hist[i - 1];

  // Solve for u_dev(k)
  double Q0 = MVC_Q[0];
  if (fabs(Q0) < 1e-15) Q0 = (Q0 >= 0) ? 1e-15 : -1e-15;
  double uDev = rhs / Q0;

  // Absolute station command
  double uRaw = (double)uBase + uDev;

  // Optional slew-rate limit (station volts per sample)
  if (isfinite(DU_ST_MAX_PER_SAMPLE)) {
    double uPrev = (double)uStationCmdV;
    double duMax = (double)DU_ST_MAX_PER_SAMPLE;
    uRaw = clampd(uRaw, uPrev - duMax, uPrev + duMax);
  }

  // Saturation in station volts
  double uSat = clampd(uRaw, U_ST_MIN_V, U_ST_MAX_V);
  satFlag = (uSat != uRaw) ? 1 : 0;

  // Store APPLIED u_dev in history (post-saturation)
  double uDevApplied = uSat - (double)uBase;
  shiftRight(u_hist, MVC_NQ - 1);
  u_hist[0] = uDevApplied;

  // Outputs for logging
  yDev_out = (float)yDev;
  rF_out = (float)rF;
  rCtrl_out = (float)rCtrl;
  uDev_out = (float)uDevApplied;

  return (float)uSat;  // station volts
}


// Bumpless enable: set base points and clear histories so u starts from current output.
void initMvcBumpless(float yNowSt, float uNowSt) {
  yBase = yNowSt;
  uBase = uNowSt;

  r_f = 0.0f;

  for (int i = 0; i < MVC_NQ - 1; ++i) u_hist[i] = 0.0;
  for (int i = 0; i < MVC_NC;     ++i) r_hist[i] = 0.0;
}


// ==================== UI ====================
void printHelp() {
  Serial.println("\n----------------------------------------");
  Serial.println("Commands:");
  Serial.println("  'e' - Enable/Disable MVC control");
  Serial.println("  'r' - Reset (MVC off), output manual u");
  Serial.println("  '+' - Increase reference output (refStationV) by 0.01 V (station output)");
  Serial.println("  '-' - Decrease reference output (refStationV) by 0.01 V (station output)");
  Serial.println("  ']' - Increase manual station input by 0.05 V (only when MVC off)");
  Serial.println("  '[' - Decrease manual station input by 0.05 V (only when MVC off)");
  Serial.println("  's' - Toggle logging to SPIFFS");
  Serial.println("  'p' - Print file contents");
  Serial.println("  'c' - Clear data file");
  Serial.println("  'i' - Show file info");
  Serial.println("  'v' - Show current values");
  Serial.println("  'h' - Help");
  Serial.println("----------------------------------------");
}


// ==================== SETUP ====================
void setup() {
  Serial.begin(115200);
  while (!Serial) { delay(10); }

  Serial.println("\n========================================");
  Serial.println("   ESP32 Temperature Station MVC/GMV");
  Serial.println("   Uses station-volts scaling + SPIFFS logging");
  Serial.println("========================================");

  initSPIFFS();

  analogReadResolution(12);
  analogSetAttenuation(ADC_11db);
  pinMode(ADC_PIN, INPUT);

  // Prime moving average
  for (int k = 0; k < AVG_WINDOW; k++) {
    delay(5);
    readAdcVoltageAveraged();
  }

  // Start in manual mode at manualUStationV
  setStationInputVoltage(manualUStationV);

  // Initialize base using current measurement
  float vAdc0 = readAdcVoltageAveraged();
  float ySt0  = adcToStationVoltage(vAdc0);
  initMvcBumpless(ySt0, uStationCmdV);

  Serial.printf("\nHardware:\n");
  Serial.printf("  ADC: GPIO %d (measures divided voltage)\n", ADC_PIN);
  Serial.printf("  DAC: GPIO %d (0..3.3V) -> amplifier -> 1..5V station input\n", DAC_PIN);
  Serial.printf("  Sample interval: %lu ms\n", SAMPLE_INTERVAL_MS);
  Serial.printf("  Avg window: %d samples (%.1f s)\n",
                AVG_WINDOW, (AVG_WINDOW * SAMPLE_INTERVAL_MS) / 1000.0f);

  Serial.printf("\nScaling:\n");
  Serial.printf("  DIV_RATIO (Vadc/Vstation) = %.6f\n", DIV_RATIO);
  Serial.printf("  Station input mapping: u_st = %.3f + %.6f * v_dac\n",
                U_ST_FROM_DAC_OFFSET, U_ST_FROM_DAC_GAIN);

  Serial.printf("\nMVC params:\n");
  Serial.printf("  Ts=%.3f s, d=%d (%.1f s), tau_ref=%.3f s, alpha=%.3f, preview=%.6f\n",
                MVC_TS_SEC, MVC_D, MVC_D*MVC_TS_SEC, MVC_TAU_REF_SEC,
                MVC_ALPHA, MVC_PREVIEW_FAC);
  Serial.printf("  Q0=%.10g, F0=%.10g\n", MVC_Q[0], MVC_F0);

  Serial.printf("\nInitial:\n");
  Serial.printf("  manualUStationV=%.3f V, refStationV=%.3f V\n", manualUStationV, refStationV);
  Serial.printf("  yBase=%.3f V, uBase=%.3f V\n", yBase, uBase);

  // Sanity: Ts match
  float TsLoop = (CTRL_UPDATE_EVERY_N_SAMPLES * SAMPLE_INTERVAL_MS) / 1000.0f;
  if (fabs(TsLoop - (float)MVC_TS_SEC) > 1e-3f) {
    Serial.printf("WARNING: Loop Ts=%.3f != MVC Ts=%.3f. Fix SAMPLE_INTERVAL_MS or CTRL_UPDATE_EVERY_N_SAMPLES.\n",
                  TsLoop, (float)MVC_TS_SEC);
  }

  printHelp();
  printFileInfo();

  Serial.println("\n>>> MVC is DISABLED. Press 'e' to enable closed-loop control. <<<\n");
}


// ==================== LOOP ====================
void loop() {
  // --- Serial commands ---
  if (Serial.available()) {
    char cmd = Serial.read();
    switch (cmd) {
      case 'e':
      case 'E': {
        mvcEnabled = !mvcEnabled;

        float vAdcNow = readAdcVoltageAveraged();
        float yStNow  = adcToStationVoltage(vAdcNow);

        if (mvcEnabled) {
          initMvcBumpless(yStNow, uStationCmdV);
          Serial.println("MVC ENABLED (bumpless).");
        } else {
          Serial.println("MVC DISABLED (manual mode).");
        }
        break;
      }

      case 'r':
      case 'R': {
        mvcEnabled = false;
        setStationInputVoltage(manualUStationV);

        float vAdcNow = readAdcVoltageAveraged();
        float yStNow  = adcToStationVoltage(vAdcNow);
        initMvcBumpless(yStNow, uStationCmdV);

        Serial.println("RESET: MVC off, output manual u, states re-initialized.");
        break;
      }

      case '+': {
        refStationV += 0.01f;
        refStationV = clampf(refStationV, Y_ST_MIN_V, Y_ST_MAX_V);
        Serial.printf("refStationV (desired y_st) = %.3f V\n", refStationV);
        break;
      }
      case '-': {
        refStationV -= 0.01f;
        refStationV = clampf(refStationV, Y_ST_MIN_V, Y_ST_MAX_V);
        Serial.printf("refStationV (desired y_st) = %.3f V\n", refStationV);
        break;
      }

      case ']': {
        manualUStationV += 0.05f;
        manualUStationV = clampf(manualUStationV, U_ST_MIN_V, U_ST_MAX_V);
        Serial.printf("manualUStationV = %.3f V\n", manualUStationV);
        if (!mvcEnabled) setStationInputVoltage(manualUStationV);
        break;
      }
      case '[': {
        manualUStationV -= 0.05f;
        manualUStationV = clampf(manualUStationV, U_ST_MIN_V, U_ST_MAX_V);
        Serial.printf("manualUStationV = %.3f V\n", manualUStationV);
        if (!mvcEnabled) setStationInputVoltage(manualUStationV);
        break;
      }

      case 's':
      case 'S':
        loggingEnabled = !loggingEnabled;
        Serial.printf("Logging %s\n", loggingEnabled ? "ENABLED" : "DISABLED");
        break;

      case 'p':
      case 'P':
        printFileContents();
        break;

      case 'c':
      case 'C':
        clearDataFile();
        break;

      case 'i':
      case 'I':
        printFileInfo();
        break;

      case 'v':
      case 'V': {
        float vAdc = readAdcVoltageAveraged();
        float ySt  = adcToStationVoltage(vAdc);

        Serial.printf("\nMVC: %s | Logging: %s\n", mvcEnabled ? "ON" : "OFF", loggingEnabled ? "ON" : "OFF");
        Serial.printf("refStationV (y_ref): %.3f V\n", refStationV);
        Serial.printf("ySt:               %.4f V (station)  [vAdc=%.4f]\n", ySt, vAdc);
        Serial.printf("uStationCmdV:      %.4f V (station)  [vDac=%.4f]\n", uStationCmdV, uDacCmdV);
        Serial.printf("yBase=%.4f, uBase=%.4f, r_f=%.4f\n\n", yBase, uBase, r_f);
        break;
      }

      case 'h':
      case 'H':
      case '?':
        printHelp();
        break;
    }
  }

  // --- Timed sampling / control / logging ---
  unsigned long now = millis();
  if (now - lastSampleTime >= SAMPLE_INTERVAL_MS) {
    lastSampleTime = now;
    sampleCount++;

    // Measurement
    float vAdcAvg  = readAdcVoltageAveraged();      // ADC node voltage
    float yStation = adcToStationVoltage(vAdcAvg);  // station output volts (1..5)

    // Controller update
    if (mvcEnabled && (sampleCount % CTRL_UPDATE_EVERY_N_SAMPLES == 0)) {
      float yDev=0, rF=0, rCtrl=0, uDev=0;
      int sat=0;

      float uStCmd = mvcStep(refStationV, yStation, yDev, rF, rCtrl, uDev, sat);
      setStationInputVoltage(uStCmd);

      if (loggingEnabled) {
        logMvcRow(now, refStationV, uStationCmdV, uDacCmdV, vAdcAvg, yStation,
                  yDev, rF, rCtrl, uDev, sat);
      }

      static unsigned long printCount = 0;
      printCount++;
      if (printCount % 5 == 0) {
        Serial.printf("t=%lu | r=%.3f y=%.3f | u_st=%.3f (dac=%.3f) | yDev=%.3f uDev=%.3f %s\n",
                      now, refStationV, yStation, uStationCmdV, uDacCmdV, yDev, uDev, sat ? "(SAT)" : "");
      }
    }
  }
}
